## boards/shields/sofle/Kconfig.defconfig
```kconfig
## -----------------------------------------------------------------
if SHIELD_SOFLE_DONGLE

config ZMK_KEYBOARD_NAME
    default "Sofle"

config ZMK_SPLIT_ROLE_CENTRAL
    default y

config ZMK_SPLIT_BLE_CENTRAL_PERIPHERALS
    default 2

config BT_MAX_CONN
    default 7

config BT_MAX_PAIRED
    default 7

config ZMK_STUDIO
    default y

config ZMK_STUDIO_LOCKING
    default n  

config ZMK_SLEEP
    default n
    
endif ## SHIELD_SOFLE_DONGLE
## -----------------------------------------------------------------
if SHIELD_SOFLE_LEFT || SHIELD_SOFLE_RIGHT

config ZMK_SPLIT_ROLE_CENTRAL
    default n

endif ## SHIELD_SOFLE_LEFT || SHIELD_SOFLE_RIGHT
## -----------------------------------------------------------------
if SHIELD_SOFLE_DONGLE || SHIELD_SOFLE_LEFT || SHIELD_SOFLE_RIGHT

config ZMK_BLE
    default y

config ZMK_SPLIT
    default y

config ZMK_SLEEP
    default y

endif ## SHIELD_SOFLE_DONGLE || SHIELD_SOFLE_LEFT || SHIELD_SOFLE_RIGHT
## -----------------------------------------------------------------
```

## config/west.yml
```yaml
manifest:
  remotes:
    - name: zmkfirmware
      url-base: https://github.com/zmkfirmware
      # https://docs.zephyrproject.org/3.2.0/develop/west/manifest.html#projects
    - name: mctechnology17
      url-base: https://github.com/mctechnology17
    - name: badjeff
      url-base: https://github.com/badjeff
    - name: mwlaboratories
      url-base: https://github.com/mwlaboratories
    - name: nrfconnect
      url-base: https://github.com/nrfconnect
  projects:
    - name: zmk
      remote: zmkfirmware
      revision: main
      import: app/west.yml
    - name: azoteq-input-module # <-- enable the drivers
      remote: mctechnology17
      revision: main
    - name: zmk-azoteq-adapter # <-- enable this module
      remote: mctechnology17
      revision: main
    - name: kb_zmk_ps2_mouse_trackpoint_driver
      remote: mwlaboratories
      revision: main
    - name: zmk-feature-split-esb
      remote: badjeff
      revision: core/move-to-zephyr-4-1
    - name: sdk-nrf
      remote: badjeff
      revision: v3.1-branch+zmk-fixes
      path: nrf
    - name: nrfxlib
      remote: nrfconnect
      revision: v3.1-branch
      repo-path: sdk-nrfxlib
      path: nrfxlib
  self:
    path: config
```
